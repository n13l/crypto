## modules/cipher/Kconfig
```kconfig
menu "Cipher algorithms"

#
# AES-128/256 (CBC, GCM)
#
config CRYPTO_CIPHER_AES
	bool

config CRYPTO_CIPHER_AES_GENERIC
	bool
	select CRYPTO_CIPHER_AES

config CRYPTO_CIPHER_AES_AWS_X86_64
	bool
	select CRYPTO_CIPHER_AES

config CRYPTO_CIPHER_AES_AWS_ARMV8
	bool
	select CRYPTO_CIPHER_AES

choice
	prompt "AES implementation"
	depends on !MODULES
	# No acceleration: portable C.
	default CRYPTO_CIPHER_AES_SEL_GENERIC if CC_CPU_ACCEL_NONE
	# Build-time: pinned to the configured target CPU.
	default CRYPTO_CIPHER_AES_SEL_AWS_X86_64 if CC_CPU_ACCEL_BUILDTIME && SRCARCH = "x86"
	default CRYPTO_CIPHER_AES_SEL_AWS_ARMV8 if CC_CPU_ACCEL_BUILDTIME && SRCARCH = "arm64"
	# Runtime: aws-lc assembly (aes_hw_* run whenever the CPU has AES-NI/CE).
	default CRYPTO_CIPHER_AES_SEL_AWS_X86_64 if CC_CPU_ACCEL_RUNTIME && SRCARCH = "x86"
	default CRYPTO_CIPHER_AES_SEL_AWS_ARMV8 if CC_CPU_ACCEL_RUNTIME && SRCARCH = "arm64"
	default CRYPTO_CIPHER_AES_SEL_GENERIC
	help
	  Select the AES-128/256 (CBC, GCM) implementation. Only one
	  implementation can be active at a time.

config CRYPTO_CIPHER_AES_SEL_N
	bool "None"
	help
	  Do not include AES support.

config CRYPTO_CIPHER_AES_SEL_GENERIC
	bool "AES (generic)"
	select CRYPTO_CIPHER_AES_GENERIC
	help
	  Portable table-based AES-128/256 (CBC and GCM modes).

config CRYPTO_CIPHER_AES_SEL_AWS_X86_64
	bool "AES (assembly, aws-lc, x86_64)"
	depends on CC_CPU_ACCELERATION && SRCARCH = "x86"
	select CRYPTO_CIPHER_AES_AWS_X86_64
	help
	  AES-128/256 using aws-lc AES-NI block/CTR/CBC assembly with CLMUL
	  GHASH for GCM, on x86_64.

config CRYPTO_CIPHER_AES_SEL_AWS_ARMV8
	bool "AES (assembly, aws-lc, ARMv8)"
	depends on CC_CPU_ACCELERATION && SRCARCH = "arm64"
	select CRYPTO_CIPHER_AES_AWS_ARMV8
	help
	  AES-128/256 using aws-lc ARMv8 Cryptography Extension assembly with
	  PMULL GHASH for GCM.

endchoice

comment "AES module (Y=built-in, M=module, N=disabled)"
	depends on MODULES

config CRYPTO_CIPHER_AES_DYN_GENERIC
	tristate "AES (generic)"
	depends on MODULES
	default m
	help
	  Portable table-based AES-128/256 (CBC and GCM modes), loadable module.

config CRYPTO_CIPHER_AES_DYN_AWS_X86_64
	tristate "AES (assembly, aws-lc, x86_64)"
	depends on MODULES && CC_CPU_ACCELERATION && SRCARCH = "x86"
	default m
	help
	  AES-128/256 aws-lc AES-NI + CLMUL GHASH assembly, loadable module.

config CRYPTO_CIPHER_AES_DYN_AWS_ARMV8
	tristate "AES (assembly, aws-lc, ARMv8)"
	depends on MODULES && CC_CPU_ACCELERATION && SRCARCH = "arm64"
	default m
	help
	  AES-128/256 aws-lc ARMv8 assembly, loadable module.

#
# ChaCha20-Poly1305 AEAD (RFC 7539)
#
config CRYPTO_CIPHER_CHACHA20
	bool

config CRYPTO_CIPHER_CHACHA20_GENERIC
	bool
	select CRYPTO_CIPHER_CHACHA20

config CRYPTO_CIPHER_CHACHA20_AWS_X86_64
	bool
	select CRYPTO_CIPHER_CHACHA20

config CRYPTO_CIPHER_CHACHA20_AWS_ARMV8
	bool
	select CRYPTO_CIPHER_CHACHA20

config CRYPTO_CIPHER_CHACHA20_AWS_FUSED_ARMV8
	bool
	select CRYPTO_CIPHER_CHACHA20

choice
	prompt "ChaCha20-Poly1305 implementation"
	depends on !MODULES
	default CRYPTO_CIPHER_CHACHA20_SEL_GENERIC if CC_CPU_ACCEL_NONE
	default CRYPTO_CIPHER_CHACHA20_SEL_AWS_X86_64 if CC_CPU_ACCEL_BUILDTIME && SRCARCH = "x86"
	default CRYPTO_CIPHER_CHACHA20_SEL_AWS_FUSED_ARMV8 if CC_CPU_ACCEL_BUILDTIME && SRCARCH = "arm64"
	default CRYPTO_CIPHER_CHACHA20_SEL_AWS_X86_64 if CC_CPU_ACCEL_RUNTIME && SRCARCH = "x86"
	default CRYPTO_CIPHER_CHACHA20_SEL_AWS_FUSED_ARMV8 if CC_CPU_ACCEL_RUNTIME && SRCARCH = "arm64"
	default CRYPTO_CIPHER_CHACHA20_SEL_GENERIC
	help
	  Select the ChaCha20-Poly1305 AEAD implementation. Only one
	  implementation can be active at a time.

config CRYPTO_CIPHER_CHACHA20_SEL_N
	bool "None"
	help
	  Do not include ChaCha20-Poly1305 support.

config CRYPTO_CIPHER_CHACHA20_SEL_GENERIC
	bool "ChaCha20-Poly1305 (generic)"
	select CRYPTO_CIPHER_CHACHA20_GENERIC
	help
	  Portable ChaCha20 stream cipher with Poly1305 authenticator (RFC 7539).

config CRYPTO_CIPHER_CHACHA20_SEL_AWS_X86_64
	bool "ChaCha20-Poly1305 (assembly, aws-lc, x86_64)"
	depends on CC_CPU_ACCELERATION && SRCARCH = "x86"
	select CRYPTO_CIPHER_CHACHA20_AWS_X86_64
	help
	  ChaCha20 keystream accelerated with aws-lc x86_64 (SSSE3/AVX2)
	  assembly; Poly1305 stays in portable C.

config CRYPTO_CIPHER_CHACHA20_SEL_AWS_ARMV8
	bool "ChaCha20-Poly1305 (assembly, aws-lc, ARMv8)"
	depends on CC_CPU_ACCELERATION && SRCARCH = "arm64"
	select CRYPTO_CIPHER_CHACHA20_AWS_ARMV8
	help
	  ChaCha20 keystream accelerated with aws-lc ARMv8 NEON assembly;
	  Poly1305 stays in portable C.

config CRYPTO_CIPHER_CHACHA20_SEL_AWS_FUSED_ARMV8
	bool "ChaCha20-Poly1305 (fused assembly, aws-lc, ARMv8)"
	depends on CC_CPU_ACCELERATION && SRCARCH = "arm64"
	select CRYPTO_CIPHER_CHACHA20_AWS_FUSED_ARMV8
	help
	  ChaCha20 and Poly1305 fused into one pass of aws-lc ARMv8 NEON
	  assembly: the rounds for the next block run on the SIMD units while
	  the authenticator carries the previous one on the scalar units,
	  instead of walking the record twice. The fastest of the three, and
	  the default on arm64. Anything outside RFC 7539 proper - a 128-bit
	  key, or a request for no authenticator - falls back to the two-pass
	  path, which is linked in beside it.

endchoice

comment "ChaCha20-Poly1305 module (Y=built-in, M=module, N=disabled)"
	depends on MODULES

config CRYPTO_CIPHER_CHACHA20_DYN_GENERIC
	tristate "ChaCha20-Poly1305 (generic)"
	depends on MODULES
	default m
	help
	  Portable ChaCha20-Poly1305 (RFC 7539), loadable module.

config CRYPTO_CIPHER_CHACHA20_DYN_AWS_X86_64
	tristate "ChaCha20-Poly1305 (assembly, aws-lc, x86_64)"
	depends on MODULES && CC_CPU_ACCELERATION && SRCARCH = "x86"
	default m
	help
	  ChaCha20 (x86_64 assembly) + Poly1305 (C), loadable module.

config CRYPTO_CIPHER_CHACHA20_DYN_AWS_ARMV8
	tristate "ChaCha20-Poly1305 (assembly, aws-lc, ARMv8)"
	depends on MODULES && CC_CPU_ACCELERATION && SRCARCH = "arm64"
	default m
	help
	  ChaCha20 (ARMv8 NEON assembly) + Poly1305 (C), loadable module.

config CRYPTO_CIPHER_CHACHA20_DYN_AWS_FUSED_ARMV8
	tristate "ChaCha20-Poly1305 (fused assembly, aws-lc, ARMv8)"
	depends on MODULES && CC_CPU_ACCELERATION && SRCARCH = "arm64"
	default m
	help
	  ChaCha20-Poly1305 fused into one ARMv8 NEON pass, loadable module.

#
# The ciphers of the TLS 1.0/1.1 suites, and of nothing newer. One backend
# each, no implementation choice and no acceleration -- they are here to read
# captures, not to run fast -- and both off by default. What turns them on is
# the insecure profile (configs/insecure.config).
#

config CRYPTO_CIPHER_DES3
	bool "3DES-EDE-CBC (for TLS 1.0/1.1 only)"
	depends on !MODULES
	default n
	help
	  Triple DES in EDE mode with CBC chaining (FIPS 46-3, RFC 1851), for
	  the *_WITH_3DES_EDE_CBC_SHA suites. The block is eight bytes, which
	  is what Sweet32 is about: a channel that negotiated one of these is
	  counted as weak (net.tls.sec_weak_ciphersuite) whether or not this is
	  built, and is opened only if it is.

	  If unsure, say N.

comment "3DES-EDE-CBC module (Y=built-in, M=module, N=disabled)"
	depends on MODULES

config CRYPTO_CIPHER_DES3_DYN
	tristate "3DES-EDE-CBC (for TLS 1.0/1.1 only)"
	depends on MODULES
	default n
	help
	  3DES-EDE-CBC as a loadable module. See CRYPTO_CIPHER_DES3.

config CRYPTO_CIPHER_RC4
	bool "RC4-128 (for TLS 1.0/1.1 only)"
	depends on !MODULES
	default n
	help
	  RC4, for the *_WITH_RC4_128_{SHA,MD5} suites. Prohibited in TLS by
	  RFC 7465, which is why a channel that negotiated one is counted as
	  insecure (net.tls.sec_insecure_ciphersuite) -- and why reading such a
	  capture is a thing someone needs to do.

	  If unsure, say N.

comment "RC4-128 module (Y=built-in, M=module, N=disabled)"
	depends on MODULES

config CRYPTO_CIPHER_RC4_DYN
	tristate "RC4-128 (for TLS 1.0/1.1 only)"
	depends on MODULES
	default n
	help
	  RC4-128 as a loadable module. See CRYPTO_CIPHER_RC4.

#
# SM4. The block cipher of the ShangMi TLS 1.3 suites (RFC 8998), in the two
# AEAD modes those name and in CBC. One backend, generic C, off by default:
# CONFIG_NET_TLS_SM in un selects it, configs/sm.config is the profile.
#

config CRYPTO_CIPHER_SM4
	bool "SM4 (GB/T 32907; CBC, GCM, CCM, for the ShangMi TLS 1.3 suites)"
	depends on !MODULES
	default n
	help
	  SM4 (GB/T 32907-2016, ISO/IEC 18033-3), a 128-bit block cipher under
	  a 128-bit key, for TLS_SM4_GCM_SM3 and TLS_SM4_CCM_SM3 (RFC 8998):
	  GCM and CCM over it, with a 12-byte nonce and a 16-byte tag, which is
	  what those two suites protect a record with. CBC is here for the
	  GB/T 38636 suites a decoder for that protocol would need.

	  One implementation, portable C, no assembly and no aws-lc variant.
	  Like MD5 and 3DES beside it this is offered whatever
	  CONFIG_CRYPTO_VERIFIED says, because the alternative is traffic
	  that cannot be read at all; unlike them it is a current cipher and a
	  channel that negotiated it is not a finding.

	  If unsure, say N.

comment "SM4 module (Y=built-in, M=module, N=disabled)"
	depends on MODULES

config CRYPTO_CIPHER_SM4_DYN
	tristate "SM4 (GB/T 32907; CBC, GCM, CCM, for the ShangMi TLS 1.3 suites)"
	depends on MODULES
	default n
	help
	  SM4 as a loadable module. See CRYPTO_CIPHER_SM4.

#
# ARIA and Camellia: the two other block ciphers the TLS 1.2 registry names
# beside AES, each in CBC and GCM at 128 and 256 bits. Generic C only, so like
# SM4 they are off by default and a CONFIG_CRYPTO_VERIFIED build has to ask;
# configs/ciphers.config is the profile that asks for both.
#

config CRYPTO_CIPHER_ARIA
	bool "ARIA (RFC 5794; CBC, GCM, for the *_WITH_ARIA_* suites)"
	depends on !MODULES
	default n
	help
	  ARIA (RFC 5794, KS X 1213), a 128-bit block cipher, for the TLS 1.2
	  suites RFC 6209 registers: ARIA_128_GCM_SHA256, ARIA_256_GCM_SHA384
	  and the CBC suites under every key exchange the registry has. GCM
	  is what OpenSSL and the deployed servers negotiate; CBC is here
	  because the registry names it.

	  One implementation, portable C, no assembly and no aws-lc variant,
	  offered whatever CONFIG_CRYPTO_VERIFIED says for the reason SM4 is.
	  A current cipher: a channel that negotiated an ARIA GCM suite is
	  not a finding, and the CBC suites are counted weak the way the AES
	  CBC suites are, for the mode and not the cipher.

	  If unsure, say N.

comment "ARIA module (Y=built-in, M=module, N=disabled)"
	depends on MODULES

config CRYPTO_CIPHER_ARIA_DYN
	tristate "ARIA (RFC 5794; CBC, GCM, for the *_WITH_ARIA_* suites)"
	depends on MODULES
	default n
	help
	  ARIA as a loadable module. See CRYPTO_CIPHER_ARIA.

config CRYPTO_CIPHER_CAMELLIA
	bool "Camellia (RFC 3713; CBC, GCM, for the *_WITH_CAMELLIA_* suites)"
	depends on !MODULES
	default n
	help
	  Camellia (RFC 3713, ISO/IEC 18033-3), a 128-bit block cipher, for
	  the TLS suites of RFC 5932 (CBC with SHA-1 and SHA-256) and RFC 6367
	  (CBC with SHA-2, and GCM). The CBC suites are what OpenSSL still
	  negotiates; the GCM suites are in the registry and in no current
	  library, and are here because a capture from one that has them is
	  the point of a decoder.

	  One implementation, portable C, offered whatever
	  CONFIG_CRYPTO_VERIFIED says for the reason SM4 and ARIA are.

	  If unsure, say N.

comment "Camellia module (Y=built-in, M=module, N=disabled)"
	depends on MODULES

config CRYPTO_CIPHER_CAMELLIA_DYN
	tristate "Camellia (RFC 3713; CBC, GCM, for the *_WITH_CAMELLIA_* suites)"
	depends on MODULES
	default n
	help
	  Camellia as a loadable module. See CRYPTO_CIPHER_CAMELLIA.

endmenu
```

## modules/hkdf/Kconfig
```kconfig
menu "HKDF algorithms"

config CRYPTO_HKDF_SHA1
	bool

config CRYPTO_HKDF_SHA2
	bool

config CRYPTO_HKDF_SHA3
	bool

choice
	prompt "HKDF-SHA-1 support"
	depends on !MODULES
	default CRYPTO_HKDF_SHA1_SEL_N
	help
	  Enable or disable HKDF-SHA-1-160 (RFC 5869).

config CRYPTO_HKDF_SHA1_SEL_N
	bool "None"
	help
	  Do not include HKDF-SHA-1 support.

config CRYPTO_HKDF_SHA1_SEL_Y
	bool "HKDF-SHA-1"
	depends on !MODULES
	select CRYPTO_HKDF_SHA1
	help
	  HKDF-SHA-1-160 HMAC-based key derivation function (RFC 5869).

endchoice

comment "HKDF-SHA-1 module (Y=built-in, M=module, N=disabled)"
	depends on MODULES

config CRYPTO_HKDF_SHA1_DYN
	tristate "HKDF-SHA-1"
	depends on MODULES
	default m
	help
	  HKDF-SHA-1-160 HMAC-based key derivation function (RFC 5869).

choice
	prompt "HKDF-SHA-2 support"
	depends on !MODULES
	default CRYPTO_HKDF_SHA2_SEL_N
	help
	  Enable or disable HKDF-SHA-224/256/384/512 (RFC 5869).

config CRYPTO_HKDF_SHA2_SEL_N
	bool "None"
	help
	  Do not include HKDF-SHA-2 support.

config CRYPTO_HKDF_SHA2_SEL_Y
	bool "HKDF-SHA-2"
	depends on !MODULES
	select CRYPTO_HKDF_SHA2
	help
	  HKDF-SHA-224/256/384/512 HMAC-based key derivation function
	  (RFC 5869).

endchoice

comment "HKDF-SHA-2 module (Y=built-in, M=module, N=disabled)"
	depends on MODULES

config CRYPTO_HKDF_SHA2_DYN
	tristate "HKDF-SHA-2"
	depends on MODULES
	default m
	help
	  HKDF-SHA-224/256/384/512 HMAC-based key derivation function
	  (RFC 5869).

choice
	prompt "HKDF-SHA-3 support"
	depends on !MODULES
	default CRYPTO_HKDF_SHA3_SEL_N
	help
	  Enable or disable HKDF-SHA-3-224/256/384/512 (RFC 5869).

config CRYPTO_HKDF_SHA3_SEL_N
	bool "None"
	help
	  Do not include HKDF-SHA-3 support.

config CRYPTO_HKDF_SHA3_SEL_Y
	bool "HKDF-SHA-3"
	depends on !MODULES
	select CRYPTO_HKDF_SHA3
	help
	  HKDF-SHA-3-224/256/384/512 HMAC-based key derivation function
	  (RFC 5869).

endchoice

comment "HKDF-SHA-3 module (Y=built-in, M=module, N=disabled)"
	depends on MODULES

config CRYPTO_HKDF_SHA3_DYN
	tristate "HKDF-SHA-3"
	depends on MODULES
	default m
	help
	  HKDF-SHA-3-224/256/384/512 HMAC-based key derivation function
	  (RFC 5869).

#
# HKDF-SM3. The key derivation of the ShangMi TLS 1.3 suites (RFC 8998 sec 3).
# Off by default, with the digest. The TLS record layer in un builds its
# HKDF-Expand from HMAC-SM3 directly (modules/net/tls/hs/tls13.h), the way it
# does for SHA-2, so what this module adds is the registry entry and the
# free-function API for anything else that wants the whole construction.
#

config CRYPTO_HKDF_SM3
	bool "HKDF-SM3 (for the ShangMi TLS 1.3 suites)"
	depends on !MODULES
	default n
	select CRYPTO_SM3
	help
	  HKDF-SM3 HMAC-based key derivation function (RFC 5869 over
	  GB/T 32905), the KDF of TLS_SM4_GCM_SM3 and TLS_SM4_CCM_SM3
	  (RFC 8998). Selects CRYPTO_SM3, which it is built on.

	  If unsure, say N.

comment "HKDF-SM3 module (Y=built-in, M=module, N=disabled)"
	depends on MODULES

config CRYPTO_HKDF_SM3_DYN
	tristate "HKDF-SM3 (for the ShangMi TLS 1.3 suites)"
	depends on MODULES
	default n
	help
	  HKDF-SM3 as a loadable module. See CRYPTO_HKDF_SM3. Needs
	  CRYPTO_SM3_DYN; configs/sm.config asks for both.

endmenu
```
