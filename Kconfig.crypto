## modules/hmac/Kconfig
```kconfig
menu "HMAC algorithms"

config CRYPTO_HMAC_SHA1
	bool

config CRYPTO_HMAC_SHA2
	bool

config CRYPTO_HMAC_SHA3
	bool

choice
	prompt "HMAC-SHA-1 support"
	depends on !MODULES
	default CRYPTO_HMAC_SHA1_SEL_Y
	help
	  Enable or disable HMAC-SHA-1-160.

config CRYPTO_HMAC_SHA1_SEL_N
	bool "None"
	help
	  Do not include HMAC-SHA-1 support.

config CRYPTO_HMAC_SHA1_SEL_Y
	bool "HMAC-SHA-1"
	depends on !MODULES
	select CRYPTO_HMAC_SHA1
	help
	  HMAC-SHA-1-160 keyed-hash message authentication code.

endchoice

comment "HMAC-SHA-1 module (Y=built-in, M=module, N=disabled)"
	depends on MODULES

config CRYPTO_HMAC_SHA1_DYN
	tristate "HMAC-SHA-1"
	depends on MODULES
	default m
	help
	  HMAC-SHA-1-160 keyed-hash message authentication code.

choice
	prompt "HMAC-SHA-2 support"
	depends on !MODULES
	default CRYPTO_HMAC_SHA2_SEL_Y
	help
	  Enable or disable HMAC-SHA-224/256/384/512.

config CRYPTO_HMAC_SHA2_SEL_N
	bool "None"
	help
	  Do not include HMAC-SHA-2 support.

config CRYPTO_HMAC_SHA2_SEL_Y
	bool "HMAC-SHA-2"
	depends on !MODULES
	select CRYPTO_HMAC_SHA2
	help
	  HMAC-SHA-224/256/384/512 keyed-hash message authentication code.

endchoice

comment "HMAC-SHA-2 module (Y=built-in, M=module, N=disabled)"
	depends on MODULES

config CRYPTO_HMAC_SHA2_DYN
	tristate "HMAC-SHA-2"
	depends on MODULES
	default m
	help
	  HMAC-SHA-224/256/384/512 keyed-hash message authentication code.

choice
	prompt "HMAC-SHA-3 support"
	depends on !MODULES
	default CRYPTO_HMAC_SHA3_SEL_Y
	help
	  Enable or disable HMAC-SHA-3-224/256/384/512.

config CRYPTO_HMAC_SHA3_SEL_N
	bool "None"
	help
	  Do not include HMAC-SHA-3 support.

config CRYPTO_HMAC_SHA3_SEL_Y
	bool "HMAC-SHA-3"
	depends on !MODULES
	select CRYPTO_HMAC_SHA3
	help
	  HMAC-SHA-3-224/256/384/512 keyed-hash message authentication code.

endchoice

comment "HMAC-SHA-3 module (Y=built-in, M=module, N=disabled)"
	depends on MODULES

config CRYPTO_HMAC_SHA3_DYN
	tristate "HMAC-SHA-3"
	depends on MODULES
	default m
	help
	  HMAC-SHA-3-224/256/384/512 keyed-hash message authentication code.

#
# HMAC-MD5. The one MD5 composition that is not broken by MD5's collisions,
# and the reason a TLS 1.0/1.1 build has the digest at all: the *_WITH_*_MD5
# suites authenticate a record with this. Off by default, with the digest.
#

config CRYPTO_HMAC_MD5
	bool "HMAC-MD5 (for TLS 1.0/1.1 only)"
	depends on !MODULES
	default n
	select CRYPTO_MD5
	help
	  HMAC-MD5 keyed-hash message authentication code (RFC 2104), for the
	  record MAC of the TLS suites whose name ends in _MD5 and for nothing
	  else. Selects CRYPTO_MD5, which it is built on.

	  If unsure, say N.

comment "HMAC-MD5 module (Y=built-in, M=module, N=disabled)"
	depends on MODULES

config CRYPTO_HMAC_MD5_DYN
	tristate "HMAC-MD5 (for TLS 1.0/1.1 only)"
	depends on MODULES
	default n
	help
	  HMAC-MD5 as a loadable module. See CRYPTO_HMAC_MD5.

	  Needs CRYPTO_MD5_DYN, and does not select it: a select on a tristate
	  forces it to y, and =y on a DYN symbol is the one shape these
	  backends do not have — the module glue compiled into the tree beside
	  the built-in.h that already inlined the same bodies.
	  configs/insecure.config asks for both.

endmenu
```

## modules/prf/Kconfig
```kconfig
menu "PRF algorithms"

config CRYPTO_PRF_SHA1
	bool

config CRYPTO_PRF_SHA2
	bool

config CRYPTO_PRF_SHA3
	bool

choice
	prompt "PRF-SHA-1 support"
	depends on !MODULES
	default CRYPTO_PRF_SHA1_SEL_Y
	help
	  Enable or disable PRF-SHA-1-160.

config CRYPTO_PRF_SHA1_SEL_N
	bool "None"
	help
	  Do not include PRF-SHA-1 support.

config CRYPTO_PRF_SHA1_SEL_Y
	bool "PRF-SHA-1"
	depends on !MODULES
	select CRYPTO_PRF_SHA1
	help
	  PRF-SHA-1-160 pseudo-random function.

endchoice

comment "PRF-SHA-1 module (Y=built-in, M=module, N=disabled)"
	depends on MODULES

config CRYPTO_PRF_SHA1_DYN
	tristate "PRF-SHA-1"
	depends on MODULES
	default m
	help
	  PRF-SHA-1-160 pseudo-random function.

choice
	prompt "PRF-SHA-2 support"
	depends on !MODULES
	default CRYPTO_PRF_SHA2_SEL_Y
	help
	  Enable or disable PRF-SHA-224/256/384/512.

config CRYPTO_PRF_SHA2_SEL_N
	bool "None"
	help
	  Do not include PRF-SHA-2 support.

config CRYPTO_PRF_SHA2_SEL_Y
	bool "PRF-SHA-2"
	depends on !MODULES
	select CRYPTO_PRF_SHA2
	help
	  PRF-SHA-224/256/384/512 pseudo-random function.

endchoice

comment "PRF-SHA-2 module (Y=built-in, M=module, N=disabled)"
	depends on MODULES

config CRYPTO_PRF_SHA2_DYN
	tristate "PRF-SHA-2"
	depends on MODULES
	default m
	help
	  PRF-SHA-224/256/384/512 pseudo-random function.

choice
	prompt "PRF-SHA-3 support"
	depends on !MODULES
	default CRYPTO_PRF_SHA3_SEL_Y
	help
	  Enable or disable PRF-SHA-3-224/256/384/512.

config CRYPTO_PRF_SHA3_SEL_N
	bool "None"
	help
	  Do not include PRF-SHA-3 support.

config CRYPTO_PRF_SHA3_SEL_Y
	bool "PRF-SHA-3"
	depends on !MODULES
	select CRYPTO_PRF_SHA3
	help
	  PRF-SHA-3-224/256/384/512 pseudo-random function.

endchoice

comment "PRF-SHA-3 module (Y=built-in, M=module, N=disabled)"
	depends on MODULES

config CRYPTO_PRF_SHA3_DYN
	tristate "PRF-SHA-3"
	depends on MODULES
	default m
	help
	  PRF-SHA-3-224/256/384/512 pseudo-random function.

#
# The TLS 1.0/1.1 PRF, which is not a P_hash: P_MD5 exclusive-ored with
# P_SHA-1 over halves of the secret. It is the whole key schedule of those two
# versions -- master secret, key block and Finished all come out of it -- and
# nothing at TLS 1.2 or above touches it. Off by default, and needs MD5.
#

config CRYPTO_PRF_TLS1
	bool "PRF-TLS-1.0/1.1 (P_MD5 XOR P_SHA-1)"
	depends on !MODULES
	default n
	select CRYPTO_MD5
	select CRYPTO_PRF_SHA1
	help
	  The pseudo-random function of TLS 1.0 and TLS 1.1 (RFC 2246 sec 5):
	  the secret is split in half and expanded twice, once under HMAC-MD5
	  and once under HMAC-SHA-1, and the two streams are exclusive-ored.

	  This is what derives a TLS 1.0/1.1 master secret, key block and
	  verify_data. TLS 1.2 replaced it with a single P_hash named by the
	  suite (CRYPTO_PRF_SHA2), so a build that reads nothing older than
	  TLS 1.2 has no use for it.

	  If unsure, say N.

comment "PRF-TLS-1.0/1.1 module (Y=built-in, M=module, N=disabled)"
	depends on MODULES

config CRYPTO_PRF_TLS1_DYN
	tristate "PRF-TLS-1.0/1.1 (P_MD5 XOR P_SHA-1)"
	depends on MODULES
	default n
	help
	  The TLS 1.0/1.1 PRF as a loadable module. See CRYPTO_PRF_TLS1.

	  Needs CRYPTO_MD5_DYN and CRYPTO_PRF_SHA1_DYN, and selects neither:
	  see the same note under CRYPTO_HMAC_MD5_DYN.
	  configs/insecure.config asks for all of them.

#
# PRF-SM3: the TLS 1.2 P_hash over SM3. No IANA suite asks for it -- the
# registered ShangMi suites are TLS 1.3 and key through HKDF -- so this exists
# to give the SM3 seam the same four shapes SHA-2 has, and off by default.
#

config CRYPTO_PRF_SM3
	bool "PRF-SM3 (P_hash over SM3)"
	depends on !MODULES
	default n
	select CRYPTO_SM3
	help
	  The TLS 1.2 pseudo-random function (RFC 5246 sec 5) with HMAC-SM3
	  as its P_hash. Nothing in the IANA registry names it: the ShangMi
	  suites of RFC 8998 are TLS 1.3 and derive through HKDF-SM3. It is
	  here so that a TLS 1.2-shaped ShangMi schedule has the primitive
	  waiting, and so that the SM3 seam is complete. Selects CRYPTO_SM3.

	  If unsure, say N.

comment "PRF-SM3 module (Y=built-in, M=module, N=disabled)"
	depends on MODULES

config CRYPTO_PRF_SM3_DYN
	tristate "PRF-SM3 (P_hash over SM3)"
	depends on MODULES
	default n
	help
	  PRF-SM3 as a loadable module. See CRYPTO_PRF_SM3. Needs
	  CRYPTO_SM3_DYN; configs/sm.config asks for both.

endmenu
```
